## config/west.yml
```yaml
manifest:
  defaults:
    revision: v0.3
  remotes:
  - name: zmkfirmware
    url-base: https://github.com/zmkfirmware
    # Additional modules containing boards/shields/custom code can be listed here as well
    # See https://docs.zephyrproject.org/3.2.0/develop/west/manifest.html#projects
  projects:
  - name: zmk
    remote: zmkfirmware
    import: app/west.yml
  - name: zmk-keyboard-chocofi
    url: https://github.com/jmacadie/zmk-keyboard-chocofi
    revision: main
    path: modules/zmk-keyboard-chocofi
  self:
    path: config
```
